/*
 * Copyright (C) 2018 Pavel Fiala 
 *               2015 Intel (Altera) Corporation 
 *
 * This program is free software; you can redistribute it and/or modify it
 * under the terms of the GNU General Public License as published by the Free
 * Software Foundation; either version 2 of the License, or (at your option)
 * any later version.
 *
 * This program is distributed in the hope that it will be useful, but WITHOUT
 * ANY WARRANTY; without even the implied warranty of MERCHANTABILITY or
 * FITNESS FOR A PARTICULAR PURPOSE. See the GNU General Public License for
 * more details.
 *
 * You should have received a copy of the GNU General Public License along with
 * this program; if not, write to the Free Software Foundation, Inc., 59 Temple
 * Place, Suite 330, Boston, MA 02111-1307 USA
 */

/dts-v1/; /plugin/;
/ {
        fragment@0 {
        target-path="/soc/fpga-region0";
        #address-cells=<1>;
        #size-cells=<1>;
        __overlay__ {
                firmware-name="altera_msgdma_socfpga.rbf";
                #address-cells=<1>;
                #size-cells=<1>;
		
                altera_pio: gpio1@ff210040 {
                            compatible = "altr,altera-gpio-1.0";
                            reg = <0xff210040 0x0000000f>;
                            reg-names = "csr";
                        };

                
                };
        };
};
